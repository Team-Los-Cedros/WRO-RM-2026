// generated by mBlock5 for MegaPi
// codes make you happy

#include <Arduino.h>
#include <Wire.h>
#include <SoftwareSerial.h>
#include <MeMegaPi.h>

double angle_rad = PI/180.0;
double angle_deg = 180.0/PI;
MeEncoderOnBoard Encoder_1(SLOT1);
MeEncoderOnBoard Encoder_2(SLOT2);
MeEncoderOnBoard Encoder_3(SLOT3);
MeEncoderOnBoard Encoder_4(SLOT4);
MeLineFollower linefollower_7(7);
MeGyro gyro_1;

void isr_process_encoder1(void){
  if(digitalRead(Encoder_1.getPortB()) == 0){
    Encoder_1.pulsePosMinus();
  }else{
    Encoder_1.pulsePosPlus();
  }
}

void isr_process_encoder2(void){
  if(digitalRead(Encoder_2.getPortB()) == 0){
    Encoder_2.pulsePosMinus();
  }else{
    Encoder_2.pulsePosPlus();
  }
}

void isr_process_encoder3(void){
  if(digitalRead(Encoder_3.getPortB()) == 0){
    Encoder_3.pulsePosMinus();
  }else{
    Encoder_3.pulsePosPlus();
  }
}

void isr_process_encoder4(void){
  if(digitalRead(Encoder_4.getPortB()) == 0){
    Encoder_4.pulsePosMinus();
  }else{
    Encoder_4.pulsePosPlus();
  }
}

void _delay(float seconds) {
  if(seconds < 0.0){
    seconds = 0.0;
  }
  long endTime = millis() + seconds * 1000;
  while(millis() < endTime) _loop();
}

void setup() {
  TCCR1A = _BV(WGM10);
  TCCR1B = _BV(CS11) | _BV(WGM12);
  TCCR2A = _BV(WGM21) | _BV(WGM20);
  TCCR2B = _BV(CS21);
  gyro_1.begin();
  attachInterrupt(Encoder_1.getIntNum(), isr_process_encoder1, RISING);
  attachInterrupt(Encoder_2.getIntNum(), isr_process_encoder2, RISING);
  Encoder_1.setPulse(8);
  Encoder_1.setRatio(46.67);
  Encoder_1.setPosPid(1.8,0,1.2);
  Encoder_1.setSpeedPid(0.18,0,0);
  Encoder_2.setPulse(8);
  Encoder_2.setRatio(46.67);
  Encoder_2.setPosPid(1.8,0,1.2);
  Encoder_2.setSpeedPid(0.18,0,0);
  // DO SOMETHING

}

void _loop() {
  gyro_1.update();
  Encoder_1.loop();
  Encoder_2.loop();
}

void loop() {
  Serial.begin(115200);
  Serial.print("LINEA ");
  Serial.println(linefollower_7.readSensors());
  Serial.print("GIRO ");
  Serial.println(gyro_1.getAngle(3));
  Serial.print("POS1 ");
  Serial.println(Encoder_1.getCurPos());
  Serial.print("POS2 ");
  Serial.println(Encoder_2.getCurPos());
  /*
  Encoder_1.setTarPWM(25/100.0*255);

  Encoder_2.setTarPWM(-50/100.0*255);
  Serial.println("POS1",Encoder_1.getCurPos());
  Serial.println("VEL1",Encoder_1.getCurrentSpeed());
  Serial.println("POS2",Encoder_2.getCurPos());
  Serial.println("VEL2",Encoder_2.getCurrentSpeed());
  _delay(2);

  Encoder_1.setTarPWM(0/100.0*255);

  Encoder_2.setTarPWM(0/100.0*255);
  Serial.println("POS1",Encoder_1.getCurPos());
  Serial.println("VEL1",Encoder_1.getCurrentSpeed());
  Serial.println("POS2",Encoder_2.getCurPos());
  Serial.println("VEL2",Encoder_2.getCurrentSpeed());
  Serial.println("LINEA",linefollower_7.readSensors());
  Serial.println("GIRO",gyro_1.getAngle(3));
  Serial.println("'FIN'");
  */
  _delay(5);

  _loop();
}