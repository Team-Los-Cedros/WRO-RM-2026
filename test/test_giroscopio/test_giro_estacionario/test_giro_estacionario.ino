// generated by mBlock5 for MegaPi
// Optimized for WRO Robomission Junior

#include <Arduino.h>
#include <Wire.h>
#include <MeMegaPi.h>

#define BOTON_PIN 4

double angle_rad = PI/180.0;
double angle_deg = 180.0/PI;
MeEncoderOnBoard Encoder_1(SLOT1); // Motor Izquierdo
MeEncoderOnBoard Encoder_2(SLOT2); // Motor Derecho

MeGyro giroscopio(8);

void isr_process_encoder1(void){
  if(digitalRead(Encoder_1.getPortB()) == 0){
    Encoder_1.pulsePosMinus();
  }else{
    Encoder_1.pulsePosPlus();
  }
}

void isr_process_encoder2(void){
  if(digitalRead(Encoder_2.getPortB()) == 0){
    Encoder_2.pulsePosMinus();
  }else{
    Encoder_2.pulsePosPlus();
  }
}

void _loop() {
  unsigned long tiempoActual = millis(); 
  // Actualizar los motores solo cada 10 milisegundos
  static unsigned long ultimoTiempoMotores = 0;
  if(tiempoActual - ultimoTiempoMotores >= 10) {
    Encoder_1.loop();
    Encoder_2.loop();
    ultimoTiempoMotores = tiempoActual;
  }
  // Actualizar el giroscopio solo cada 50 milisegundos
  static unsigned long ultimoGiroscopio = 0;
  if(tiempoActual - ultimoGiroscopio >= 50) {
    giroscopio.update();
    ultimoGiroscopio = tiempoActual;
  }
}

void _delay(float seconds) {
  if(seconds < 0.0){
    seconds = 0.0;
  }
  // Se cambia 'long' por 'unsigned long' para compatibilidad con millis()
  unsigned long endTime = millis() + (unsigned long)(seconds * 1000.0);
  
  while(millis() < endTime) {
    _loop();
    delay(2); // <--- ESTA LÍNEA ES LA MAGIA. Evita que la placa colapse.
  }
}

void setup() {
  Serial.begin(115200);
  giroscopio.begin();
  Wire.setWireTimeout(3000, true); // 3000 microsegundos, reset automático del bus si se cuelga
  delay(2000);
  
  //MOTORES

  TCCR1A = _BV(WGM10);
  TCCR1B = _BV(CS11) | _BV(WGM12);
  TCCR2A = _BV(WGM21) | _BV(WGM20);
  TCCR2B = _BV(CS21);
  
  attachInterrupt(Encoder_1.getIntNum(), isr_process_encoder1, RISING);
  Encoder_1.setPulse(8);
  Encoder_1.setRatio(46.67);
  Encoder_1.setPosPid(1.8,0,1.2);
  Encoder_1.setSpeedPid(0.18,0,0);
  
  attachInterrupt(Encoder_2.getIntNum(), isr_process_encoder2, RISING);
  Encoder_2.setPulse(8);
  Encoder_2.setRatio(46.67);
  Encoder_2.setPosPid(1.8,0,1.2);
  Encoder_2.setSpeedPid(0.18,0,0);

  Serial.println("Run");
}

void loop() {
  Encoder_1.loop();
  Encoder_2.loop();
  giroscopio.update();

  Serial.print("Quieto (sin motor): ");

  Serial.println(giroscopio.getAngleZ());
  _delay(0.2);

  static bool motorEncendido = false;
  if (millis() > 5000 && millis() < 30000 && !motorEncendido) {
    Encoder_1.runSpeed(-100);
    Encoder_2.runSpeed(-300);
    motorEncendido = true;
    Serial.println("=== MOTOR ENCENDIDO, ROBOT LEVANTADO DEL PISO ===");
  } else if (millis() > 30000 && millis() < 60000 && motorEncendido) {
    Encoder_1.runSpeed(0);
    Encoder_2.runSpeed(0);
    motorEncendido = false;
  } else if (millis() > 60000 && !motorEncendido) {
    Encoder_1.runSpeed(300);
    Encoder_2.runSpeed(100);
    motorEncendido = true;
  }
}