// generated by mBlock5 for MegaPi
// Optimized for WRO Robomission Junior

#include <Arduino.h>
#include <Wire.h>
#include <SoftwareSerial.h>
#include <MeMegaPi.h>

#define BOTON_PIN 4

MeGyro giroscopio(8);

MePort placaExpansora(7); // Define el Puerto 7 como adaptador RJ25
Servo servoGarra1;
Servo servoGarra2;

double angle_rad = PI/180.0;
double angle_deg = 180.0/PI;
MeEncoderOnBoard Encoder_1(SLOT1); // Motor Izquierdo
MeEncoderOnBoard Encoder_2(SLOT2); // Motor Derecho

void isr_process_encoder1(void){
  if(digitalRead(Encoder_1.getPortB()) == 0){
    Encoder_1.pulsePosMinus();
  }else{
    Encoder_1.pulsePosPlus();
  }
}

void isr_process_encoder2(void){
  if(digitalRead(Encoder_2.getPortB()) == 0){
    Encoder_2.pulsePosMinus();
  }else{
    Encoder_2.pulsePosPlus();
  }
}

// Variable para saber si estamos en espera o si el robot ya está compitiendo
bool rutinaIniciada = false;

void _loop() {
  unsigned long tiempoActual = millis(); 
  
  // Actualizar los motores solo cada 10 milisegundos
  static unsigned long ultimoTiempoMotores = 0;
  if(tiempoActual - ultimoTiempoMotores >= 10) {
    Encoder_1.loop();
    Encoder_2.loop();
    ultimoTiempoMotores = tiempoActual;
  }
  
  // Actualizar el giroscopio solo cada 50 milisegundos
  static unsigned long ultimoGiroscopio = 0;
  if(tiempoActual - ultimoGiroscopio >= 25) {
    giroscopio.update();
    ultimoGiroscopio = tiempoActual;
  }

  // Si la rutina ya empezó y el botón se vuelve a presionar (estado LOW)
  if (rutinaIniciada == true && digitalRead(BOTON_PIN) == LOW) {
    // 1. Mandamos la orden de velocidad y posición a 0
    Encoder_1.move(0, 0); 
    Encoder_2.move(0, 0);
    // Forzar el PWM a 0
    Encoder_1.setTarPWM(0);
    Encoder_2.setTarPWM(0);
    
    // Guardamos el momento exacto en el que empezamos a frenar
    unsigned long inicioParada = millis();
    
    // 2. Atrapamos al robot en un bucle infinito
    while (true) {
      tiempoActual = millis(); 
      
      // FASE 1: Durante los primeros 1500ms, mantenemos vivo el cerebro del motor para que frene
      if (tiempoActual - inicioParada < 1500) {
        if(tiempoActual - ultimoTiempoMotores >= 10) {
          Encoder_1.loop();
          Encoder_2.loop();
          ultimoTiempoMotores = tiempoActual;
        }
      } 
      // FASE 2: Pasados los 500ms, ya no entra al 'if' anterior. 
      // Al dejar de llamar a .loop(), los motores pierden la tensión y el zumbido desaparece.
      else {
        // El robot está congelado, los motores apagados y sin zumbar.
        delay(500);
      }
    }
  }
}

void _delay(float seconds) {
  if(seconds < 0.0){
    seconds = 0.0;
  }
  // Se cambia 'long' por 'unsigned long' para compatibilidad con millis()
  unsigned long endTime = millis() + (unsigned long)(seconds * 1000.0);
  
  while(millis() < endTime) {
    _loop();
    delay(2); // <--- ESTA LÍNEA ES LA MAGIA. Evita que la placa colapse.
  }
}

// =========================================================================
// NUESTRAS FUNCIONES DE MOVIMIENTO
// =========================================================================

/**
 * Función maestra para controlar ambos motores.
 * Para ambos motores: valores positivos = adelante, valores negativos = atrás.
 */
void moverRobot(long gradosIzq, long gradosDer, float velocidad, float tiempoEspera) {
  // Encoder_1 (Izquierdo): se queda igual
  Encoder_1.move(gradosIzq, abs(velocidad));
  
  // Encoder_2 (Derecho): se invierte con el signo menos (-) 
  // para que los valores positivos vayan hacia adelante.
  Encoder_2.move(-gradosDer, abs(velocidad*1.02));
  
  _delay(tiempoEspera);
}

// Mueve el robot en línea recta hacia adelante
void avanzar(long grados, float velocidad, float tiempoEspera) {
  moverRobot(grados, grados, velocidad, tiempoEspera);
}

// Mueve el robot en línea recta hacia atrás
void retroceder(long grados, float velocidad, float tiempoEspera) {
  moverRobot(-grados, -grados, velocidad, tiempoEspera);
}

// Gira sobre su propio eje hacia la derecha
void girarIzquierda(long grados, float velocidad, float tiempoEspera) {
  moverRobot(grados, -grados, velocidad, tiempoEspera);
}

// Gira sobre su propio eje hacia la izquierda
void girarDerecha(long grados, float velocidad, float tiempoEspera) {
  moverRobot(-grados, grados, velocidad, tiempoEspera);
}

// Detiene por completo los motores
void detener(float tiempoEspera) {
  Encoder_1.setTarPWM(0);
  Encoder_2.setTarPWM(0);
}

// =========================================================================
// FUNCIONES DE GIRO CON GIROSCOPIO
// =========================================================================

void girarDerechaGyro(float gradosObjetivo, float velocidad) {
  giroscopio.update();
  float anguloInicial = giroscopio.getAngleZ();

  Encoder_1.runSpeed(-abs(velocidad));
  Encoder_2.runSpeed(-abs(velocidad));

  unsigned long tiempoInicio = millis();
  const unsigned long TIMEOUT_MS = 5000; // ajusta según tus giros más largos

  int contador = 0;
  while (abs(giroscopio.getAngleZ() - anguloInicial) < gradosObjetivo) {
    _loop();
    /*
     if (++contador % 50 == 0) {  // imprime 1 de cada 50 lecturas
      Serial.println(giroscopio.getAngleZ());
    }
    */
    if (millis() - tiempoInicio > TIMEOUT_MS) {
      Serial.println("TIMEOUT en giro derecha - saliendo por seguridad");
      break; // evita el bucle infinito
    }
  }
  Encoder_1.runSpeed(0);
  Encoder_2.runSpeed(0);
  _delay(0.3);
}

void girarIzquierdaGyro(float gradosObjetivo, float velocidad) {
 giroscopio.update();
  float anguloInicial = giroscopio.getAngleZ();

  Encoder_1.runSpeed(abs(velocidad));
  Encoder_2.runSpeed(abs(velocidad));

  unsigned long tiempoInicio = millis();
  const unsigned long TIMEOUT_MS = 5000; // ajusta según tus giros más largos

  int contador = 0;
  while (abs(giroscopio.getAngleZ() - anguloInicial) < gradosObjetivo) {
    _loop();
    /*
    if (++contador % 50 == 0) {  // imprime 1 de cada 50 lecturas
      Serial.println(giroscopio.getAngleZ());
    }
    */
    if (millis() - tiempoInicio > TIMEOUT_MS) {
      Serial.println("TIMEOUT en giro izquierda - saliendo por seguridad");
      break; // evita el bucle infinito
    }
  }
  Encoder_1.runSpeed(0);
  Encoder_2.runSpeed(0);
  _delay(0.3);
}

// =========================================================================
// DE LOS SERVOMOTORES PEQUEÑOS
// =========================================================================

const int GARRA_ABIERTA_S1 = 0;
const int GARRA_CERRADA_S1 = 126;
const int GARRA_CERRADA_S2 = 50;
const int GARRA_ABIERTA_S2 = 180;

void abrirGarra() {
  servoGarra1.write(GARRA_ABIERTA_S1);
  servoGarra2.write(GARRA_ABIERTA_S2);
  _delay(1.0);
}

void cerrarGarra() {
  servoGarra1.write(GARRA_CERRADA_S1);
  servoGarra2.write(GARRA_CERRADA_S2);
  _delay(1.0);
}

// =========================================================================
// DEL SERVOMOTOR GRANDE
// =========================================================================

// Creamos el objeto servo
Servo miServo;
// Definimos el pin del servo
const int pinServo = 5;

// Mueve el servo 90° hacia arriba (va a 180°)
const int anguloBajar = 117;
void subir_pala() {
  for (int angulo = anguloBajar; angulo >= 0; angulo--) {
    miServo.write(angulo);
    _delay(0.050); // Ajusta este tiempo para cambiar la velocidad
  }
  _delay(1.0);
}

// Regresa el servo a la posición central (90°)
void bajar_pala() {
  miServo.write(anguloBajar);
  _delay(1.0);
}

// Baja el servo 35° desde el centro (90 - 35 = 55°)
void barrer() {
  abrirGarra();
  miServo.write(117);
  _delay(1.0);
}

// Subir el servo para llevar el objeto
void recolectar(int modo) {
  if (modo == 1) {
    miServo.write(97);
    
  } else if (modo == 2) {
    miServo.write(90);
  }
  _delay(1.0);
}

// Subir el servo para llevar el objeto
void posicionar() {
  miServo.write(50);
  _delay(1.0);
}

// Bajar el servo para soltar el objeto
void depositar() {
  miServo.write(40);
  _delay(1.0);
  abrirGarra();
}

// =========================================================================

void setup() {
  Serial.begin(115200);

  pinMode(BOTON_PIN, INPUT_PULLUP); 
  
  Wire.setWireTimeout(3000, true); // 3000 microsegundos, reset automático del bus si se cuelga
  giroscopio.begin(); // <-- AÑADE ESTA LÍNEA
  _delay(2.0);    // <-- AÑADE ESTA LÍNEA (Espera 2 segundos completamente quieto)

  // Asociamos el SERVO al pin 5
  miServo.attach(pinServo);
  // Inicializar los microservomotores
  // Se asignan los servos a los pines físicos extraídos del puerto 7
  servoGarra1.attach(placaExpansora.pin1());
  servoGarra2.attach(placaExpansora.pin2());
  
  // Posición inicial por defecto: siempre en 180 grados
  miServo.write(0);

  // Inicializamos los pines de los servos
  servoGarra1.attach(placaExpansora.pin1());
  servoGarra2.attach(placaExpansora.pin2());
  
  // Condición inicial: Empezar con la garra abierta
  abrirGarra();

  //MOTORES

  TCCR1A = _BV(WGM10);
  TCCR1B = _BV(CS11) | _BV(WGM12);
  TCCR2A = _BV(WGM21) | _BV(WGM20);
  TCCR2B = _BV(CS21);
  
  attachInterrupt(Encoder_1.getIntNum(), isr_process_encoder1, RISING);
  Encoder_1.setPulse(8);
  Encoder_1.setRatio(46.67);
  Encoder_1.setPosPid(1.8,0,1.2);
  Encoder_1.setSpeedPid(0.18,0,0);
  
  attachInterrupt(Encoder_2.getIntNum(), isr_process_encoder2, RISING);
  Encoder_2.setPulse(8);
  Encoder_2.setRatio(46.67);
  Encoder_2.setPosPid(1.8,0,1.2);
  Encoder_2.setSpeedPid(0.18,0,0);
}

void loop() {
  Serial.println("Up");

  // 1. ESPERAR A QUE SE PRESIONE EL BOTÓN PARA INICIAR
  while (digitalRead(BOTON_PIN) == HIGH) {
    _loop(); 
  }
  // 2. ESPERAR A QUE SE SUELTE EL BOTÓN. Esto evita que te canceles a ti mismo por dejar el dedo puesto
  while (digitalRead(BOTON_PIN) == LOW) {
    _loop();
  }
  // 3. PAUSA DE SEGURIDAD
  _delay(0.5);
  // 4. ¡ACTIVAR EL MODO COMPETENCIA!
  // A partir de esta línea, si presionas el botón, el robot se detendrá por completo
  rutinaIniciada = true;

  // ==========================================
  // TU RUTINA DE MOVIMIENTO
  // ==========================================
  
  avanzar(580, 90, 3.0);
  
  //girarIzquierda(329, 55, 3.5);
  girarIzquierdaGyro(80.0, 50.0);
  avanzar(271, 80, 2.6);
  girarDerechaGyro(77.0, 39.0);
  avanzar(206, 80, 2.5);
  
  bajar_pala();

  retroceder(1650, 33, 4.5);
  avanzar(85, 120, 0.5);
  girarDerechaGyro(95.0, 30.0);
  
  avanzar(2000, 100, 2); 
  avanzar(2000, 105, 2.25);
  retroceder(45, 40, 1.0);
  
  detener(1.0);
  subir_pala();
 

  // Bucle infinito para que no repita la rutina en la competencia
  while(1) {
    _loop();
  }
}