// generated by mBlock5 for MegaPi
// Optimized for WRO Robomission Junior

#include <Arduino.h>
#include <Wire.h>
#include <SoftwareSerial.h>
#include <MeMegaPi.h>

#define BOTON_PIN 4
#define PIN_TCRT_IZQ A4
#define PIN_TCRT_DER A3

MeGyro giroscopio(8);

MePort placaExpansora(7); // Define el Puerto 7 como adaptador RJ25
Servo servoGarra1;
Servo servoGarra2;

double angle_rad = PI/180.0;
double angle_deg = 180.0/PI;
MeEncoderOnBoard Encoder_1(SLOT1); // Motor Izquierdo
MeEncoderOnBoard Encoder_2(SLOT2); // Motor Derecho

void isr_process_encoder1(void){
  if(digitalRead(Encoder_1.getPortB()) == 0){
    Encoder_1.pulsePosMinus();
  }else{
    Encoder_1.pulsePosPlus();
  }
}

void isr_process_encoder2(void){
  if(digitalRead(Encoder_2.getPortB()) == 0){
    Encoder_2.pulsePosMinus();
  }else{
    Encoder_2.pulsePosPlus();
  }
}

// Variable para saber si estamos en espera o si el robot ya está compitiendo
bool rutinaIniciada = false;

void _loop() {
  unsigned long tiempoActual = millis(); 
  
  // Actualizar los motores solo cada 10 milisegundos
  static unsigned long ultimoTiempoMotores = 0;
  if(tiempoActual - ultimoTiempoMotores >= 10) {
    Encoder_1.loop();
    Encoder_2.loop();
    ultimoTiempoMotores = tiempoActual;
  }
  
  // Actualizar el giroscopio solo cada 50 milisegundos
  static unsigned long ultimoGiroscopio = 0;
  if(tiempoActual - ultimoGiroscopio >= 25) {
    giroscopio.update();
    ultimoGiroscopio = tiempoActual;
  }

  // Si la rutina ya empezó y el botón se vuelve a presionar (estado LOW)
  if (rutinaIniciada == true && digitalRead(BOTON_PIN) == LOW) {
    // 1. Mandamos la orden de velocidad y posición a 0
    Encoder_1.move(0, 0); 
    Encoder_2.move(0, 0);
    // Forzar el PWM a 0
    Encoder_1.setTarPWM(0);
    Encoder_2.setTarPWM(0);
    
    // Guardamos el momento exacto en el que empezamos a frenar
    unsigned long inicioParada = millis();
    
    // 2. Atrapamos al robot en un bucle infinito
    while (true) {
      tiempoActual = millis(); 
      
      // FASE 1: Durante los primeros 1500ms, mantenemos vivo el cerebro del motor para que frene
      if (tiempoActual - inicioParada < 1500) {
        if(tiempoActual - ultimoTiempoMotores >= 10) {
          Encoder_1.loop();
          Encoder_2.loop();
          ultimoTiempoMotores = tiempoActual;
        }
      } 
      // FASE 2: Pasados los 500ms, ya no entra al 'if' anterior. 
      // Al dejar de llamar a .loop(), los motores pierden la tensión y el zumbido desaparece.
      else {
        // El robot está congelado, los motores apagados y sin zumbar.
        delay(500);
      }
    }
  }
}

void _delay(float seconds) {
  if(seconds < 0.0){
    seconds = 0.0;
  }
  // Se cambia 'long' por 'unsigned long' para compatibilidad con millis()
  unsigned long endTime = millis() + (unsigned long)(seconds * 1000.0);
  
  while(millis() < endTime) {
    _loop();
    delay(2); // <--- ESTA LÍNEA ES LA MAGIA. Evita que la placa colapse.
  }
}

// =========================================================================
// NUESTRAS FUNCIONES DE MOVIMIENTO
// =========================================================================

/**
 * Función maestra para controlar ambos motores.
 * Para ambos motores: valores positivos = adelante, valores negativos = atrás.
 */
void moverRobot(long gradosIzq, long gradosDer, float velocidad, float tiempoEspera) {
  // Encoder_1 (Izquierdo): se queda igual
  Encoder_1.move(gradosIzq, abs(velocidad));
  
  // Encoder_2 (Derecho): se invierte con el signo menos (-) 
  // para que los valores positivos vayan hacia adelante.
  Encoder_2.move(-gradosDer, abs(velocidad*1.02));
  
  _delay(tiempoEspera);
}

// Mueve el robot en línea recta hacia adelante
void avanzar(long grados, float velocidad, float tiempoEspera) {
  moverRobot(grados, grados, velocidad, tiempoEspera);
}

// Mueve el robot en línea recta hacia atrás
void retroceder(long grados, float velocidad, float tiempoEspera) {
  moverRobot(-grados, -grados, velocidad, tiempoEspera);
}

// Gira sobre su propio eje hacia la derecha
void girarIzquierda(long grados, float velocidad, float tiempoEspera) {
  moverRobot(grados, -grados, velocidad, tiempoEspera);
}

// Gira sobre su propio eje hacia la izquierda
void girarDerecha(long grados, float velocidad, float tiempoEspera) {
  moverRobot(-grados, grados, velocidad, tiempoEspera);
}

// Detiene por completo los motores
void detener(float tiempoEspera) {
  Encoder_1.setTarPWM(0);
  Encoder_2.setTarPWM(0);
}

// =========================================================================
// FUNCIONES DE GIRO CON GIROSCOPIO
// =========================================================================

void girarDerechaGyro(float gradosObjetivo, float velocidad) {
  giroscopio.update();
  float anguloInicial = giroscopio.getAngleZ();

  Encoder_1.runSpeed(-abs(velocidad));
  Encoder_2.runSpeed(-abs(velocidad));

  unsigned long tiempoInicio = millis();
  const unsigned long TIMEOUT_MS = 5000; // ajusta según tus giros más largos

  int contador = 0;
  while (abs(giroscopio.getAngleZ() - anguloInicial) < gradosObjetivo) {
    _loop();
    /*
     if (++contador % 50 == 0) {  // imprime 1 de cada 50 lecturas
      Serial.println(giroscopio.getAngleZ());
    }
    */
    if (millis() - tiempoInicio > TIMEOUT_MS) {
      Serial.println("TIMEOUT en giro derecha - saliendo por seguridad");
      break; // evita el bucle infinito
    }
  }
  Encoder_1.runSpeed(0);
  Encoder_2.runSpeed(0);
  _delay(0.3);
}

void girarIzquierdaGyro(float gradosObjetivo, float velocidad) {
 giroscopio.update();
  float anguloInicial = giroscopio.getAngleZ();

  Encoder_1.runSpeed(abs(velocidad));
  Encoder_2.runSpeed(abs(velocidad));

  unsigned long tiempoInicio = millis();
  const unsigned long TIMEOUT_MS = 5000; // ajusta según tus giros más largos

  int contador = 0;
  while (abs(giroscopio.getAngleZ() - anguloInicial) < gradosObjetivo) {
    _loop();
    /*
    if (++contador % 50 == 0) {  // imprime 1 de cada 50 lecturas
      Serial.println(giroscopio.getAngleZ());
    }
    */
    if (millis() - tiempoInicio > TIMEOUT_MS) {
      Serial.println("TIMEOUT en giro izquierda - saliendo por seguridad");
      break; // evita el bucle infinito
    }
  }
  Encoder_1.runSpeed(0);
  Encoder_2.runSpeed(0);
  _delay(0.3);
}

// =========================================================================
// SENSORES DE LÍNEA TCRT5000 Y NAVEGACIÓN
// =========================================================================

// Umbral analógico para diferenciar superficie clara de línea negra
int UMBRAL_NEGRO_DER = 55;
int UMBRAL_NEGRO_IZQ = 31;

int leerLineaIzq() {
  return analogRead(PIN_TCRT_IZQ);
}

int leerLineaDer() {
  return analogRead(PIN_TCRT_DER);
}

bool esNegroIzq() {
  return leerLineaIzq() >= UMBRAL_NEGRO_IZQ;
}

bool esNegroDer() {
  return leerLineaDer() >= UMBRAL_NEGRO_DER;
}

void imprimirSensoresLinea() {
  Serial.print("TCRT Izq (A4): ");
  Serial.print(leerLineaIzq());
  Serial.print(" | TCRT Der (A3): ");
  Serial.println(leerLineaDer());
}

/**
 * Centra el robot sobre la línea negra usando micro-ajustes.
 */
void centrarEnLinea(float velocidad, float timeoutSeg) {
  unsigned long inicio = millis();
  unsigned long timeoutMs = (unsigned long)(timeoutSeg * 1000.0);
  float velFina = abs(velocidad) * 0.6; // Velocidad reducida para mayor precisión

  while (millis() - inicio < timeoutMs) {
    _loop();
    bool izqNegro = esNegroIzq();
    bool derNegro = esNegroDer();

    // Si ambos detectan negro o ambos blanco, el robot ya está centrado
    if ((izqNegro && derNegro) || (!izqNegro && !derNegro)) {
      Encoder_1.runSpeed(0);
      Encoder_2.runSpeed(0);
      break;
    } 
    else if (izqNegro && !derNegro) {
      // Línea hacia la izquierda -> girar izquierda
      Encoder_1.runSpeed(velFina);
      Encoder_2.runSpeed(velFina);
    } 
    else if (!izqNegro && derNegro) {
      // Línea hacia la derecha -> girar derecha
      Encoder_1.runSpeed(-velFina);
      Encoder_2.runSpeed(-velFina);
    }
    delay(5);
  }

  Encoder_1.runSpeed(0);
  Encoder_2.runSpeed(0);
  _delay(0.1);
}

/**
 * Girar a la izquierda con giroscopio y centrarse en la línea negra al detectarla.
 * 
 * @param gradosMaximos Límite máximo de grados a girar si el sensor no detecta la línea.
 * @param velocidad Velocidad de giro.
 * @param gradosMinimosBusqueda Grados transcurridos ANTES de activar la búsqueda por sensor (evita lecturas falsas al iniciar).
 * @param timeoutSeg Tiempo límite de seguridad en segundos.
 */
void girarIzquierdaGyroLinea(float gradosMaximos, float velocidad, float gradosMinimosBusqueda, float timeoutSeg = 4.0) {
  giroscopio.update();
  float anguloInicial = giroscopio.getAngleZ();
  unsigned long tiempoInicio = millis();
  unsigned long timeoutMs = (unsigned long)(timeoutSeg * 1000.0);

  Encoder_1.runSpeed(abs(velocidad));
  Encoder_2.runSpeed(abs(velocidad));

  bool lineaDetectada = false;

  while (abs(giroscopio.getAngleZ() - anguloInicial) < gradosMaximos) {
    _loop();
    float gradosGirados = abs(giroscopio.getAngleZ() - anguloInicial);

    // Activar la lectura de la línea solo después de cumplir los grados/pasos mínimos
    if (gradosGirados >= gradosMinimosBusqueda) {
      if (esNegroIzq() || esNegroDer()) {
        lineaDetectada = true;
        break; // Detener giro inmediatamente al detectar la línea
      }
    }

    if (millis() - tiempoInicio > timeoutMs) {
      Serial.println("TIMEOUT en girarIzquierdaGyroLinea - saliendo por seguridad");
      break;
    }
  }

  Encoder_1.runSpeed(0);
  Encoder_2.runSpeed(0);
  _delay(0.1);

  // Si se detectó la línea, realizar el centrado fino
  if (lineaDetectada) {
    centrarEnLinea(velocidad, 40.0);
  }
}

/**
 * Girar a la derecha con giroscopio y centrarse en la línea negra al detectarla.
 * 
 * @param gradosMaximos Límite máximo de grados a girar si el sensor no detecta la línea.
 * @param velocidad Velocidad de giro.
 * @param gradosMinimosBusqueda Grados transcurridos ANTES de activar la búsqueda por sensor.
 * @param timeoutSeg Tiempo límite de seguridad en segundos.
 */
void girarDerechaGyroLinea(float gradosMaximos, float velocidad, float gradosMinimosBusqueda, float timeoutSeg = 4.0) {
  giroscopio.update();
  float anguloInicial = giroscopio.getAngleZ();
  unsigned long tiempoInicio = millis();
  unsigned long timeoutMs = (unsigned long)(timeoutSeg * 1000.0);

  Encoder_1.runSpeed(-abs(velocidad));
  Encoder_2.runSpeed(-abs(velocidad));

  bool lineaDetectada = false;

  while (abs(giroscopio.getAngleZ() - anguloInicial) < gradosMaximos) {
    _loop();
    float gradosGirados = abs(giroscopio.getAngleZ() - anguloInicial);

    if (gradosGirados >= gradosMinimosBusqueda) {
      if (esNegroIzq() || esNegroDer()) {
        lineaDetectada = true;
        break;
      }
    }

    if (millis() - tiempoInicio > timeoutMs) {
      Serial.println("TIMEOUT en girarDerechaGyroLinea - saliendo por seguridad");
      break;
    }
  }

  Encoder_1.runSpeed(0);
  Encoder_2.runSpeed(0);
  _delay(0.1);

  if (lineaDetectada) {
    centrarEnLinea(velocidad, 40.0);
  }
}

/**
 * Avanza siguiendo la línea negra durante un tiempo determinado (en segundos).
 * 
 * @param segundos Tiempo total de avance.
 * @param velocidadBase Velocidad crucero del robot.
 * @param Kp Constante de proporcionalidad para el ajuste de dirección.
 */
void seguirLineaTiempo(float segundos, float velocidadBase, float Kp = 0.15) {
  unsigned long inicio = millis();
  unsigned long duracionMs = (unsigned long)(segundos * 1000.0);

  while (millis() - inicio < duracionMs) {
    _loop();

    int lectIzq = leerLineaIzq();
    int lectDer = leerLineaDer();

    // Diferencia proporcional entre ambos sensores
    int error = lectIzq - lectDer;
    float correccion = error * Kp;

    float velIzq = velocidadBase - correccion;
    float velDer = velocidadBase + correccion;

    Encoder_1.runSpeed(velIzq);
    Encoder_2.runSpeed(-velDer);

    delay(5);
  }

  Encoder_1.runSpeed(0);
  Encoder_2.runSpeed(0);
  _delay(0.1);
}

/**
 * Avanza siguiendo la línea negra durante una cantidad determinada de grados/pasos de encoder.
 * 
 * @param grados Grados de avance requeridos en los motores.
 * @param velocidadBase Velocidad crucero del robot.
 * @param Kp Constante de proporcionalidad.
 * @param tiempoMax Tiempo límite de seguridad por timeout.
 */
void seguirLineaGrados(long grados, float velocidadBase, float Kp = 0.15, float tiempoMax = 10.0) {
  long posInicialIzq = Encoder_1.getCurPos();
  long posInicialDer = Encoder_2.getCurPos();

  unsigned long inicio = millis();
  unsigned long timeoutMs = (unsigned long)(tiempoMax * 1000.0);

  while (millis() - inicio < timeoutMs) {
    _loop();

    long avanceIzq = abs(Encoder_1.getCurPos() - posInicialIzq);
    long avanceDer = abs(Encoder_2.getCurPos() - posInicialDer);
    long promedioAvance = (avanceIzq + avanceDer) / 2;

    if (promedioAvance >= grados) {
      break;
    }

    int lectIzq = leerLineaIzq();
    int lectDer = leerLineaDer();

    int error = lectIzq - lectDer;
    float correccion = error * Kp;

    float velIzq = velocidadBase - correccion;
    float velDer = velocidadBase + correccion;

    Encoder_1.runSpeed(velIzq);
    Encoder_2.runSpeed(-velDer);

    delay(5);
  }

  Encoder_1.runSpeed(0);
  Encoder_2.runSpeed(0);
  _delay(0.1);
}

// =========================================================================
// DE LOS SERVOMOTORES PEQUEÑOS
// =========================================================================

const int GARRA_ABIERTA_S1 = 0;
const int GARRA_CERRADA_S1 = 126;
const int GARRA_CERRADA_S2 = 50;
const int GARRA_ABIERTA_S2 = 180;

void abrirGarra() {
  servoGarra1.write(GARRA_ABIERTA_S1);
  servoGarra2.write(GARRA_ABIERTA_S2);
  _delay(1.0);
}

void cerrarGarra() {
  servoGarra1.write(GARRA_CERRADA_S1);
  servoGarra2.write(GARRA_CERRADA_S2);
  _delay(1.0);
}

// =========================================================================
// DEL SERVOMOTOR GRANDE
// =========================================================================

// Creamos el objeto servo
Servo miServo;
// Definimos el pin del servo
const int pinServo = 5;

// Mueve el servo 90° hacia arriba (va a 180°)
const int anguloBajar = 117;
void subir_pala() {
  for (int angulo = anguloBajar; angulo >= 0; angulo--) {
    miServo.write(angulo);
    _delay(0.050); // Ajusta este tiempo para cambiar la velocidad
  }
  _delay(1.0);
}

// Regresa el servo a la posición central (90°)
void bajar_pala() {
  miServo.write(anguloBajar);
  _delay(1.0);
}

// Baja el servo 35° desde el centro (90 - 35 = 55°)
void barrer() {
  abrirGarra();
  miServo.write(117);
  _delay(1.0);
}

// Subir el servo para llevar el objeto
void recolectar(int modo) {
  if (modo == 1) {
    miServo.write(97);
    
  } else if (modo == 2) {
    miServo.write(90);
  }
  _delay(1.0);
}

// Subir el servo para llevar el objeto
void posicionar() {
  miServo.write(50);
  _delay(1.0);
}

// Bajar el servo para soltar el objeto
void depositar() {
  miServo.write(40);
  _delay(1.0);
  abrirGarra();
}

// =========================================================================

void setup() {
  Serial.begin(115200);

  pinMode(BOTON_PIN, INPUT_PULLUP); 
  pinMode(PIN_TCRT_IZQ, INPUT);
  pinMode(PIN_TCRT_DER, INPUT);
  
  Wire.setWireTimeout(3000, true); // 3000 microsegundos, reset automático del bus si se cuelga
  giroscopio.begin(); // <-- AÑADE ESTA LÍNEA
  _delay(2.0);    // <-- AÑADE ESTA LÍNEA (Espera 2 segundos completamente quieto)

  // Asociamos el SERVO al pin 5
  miServo.attach(pinServo);
  // Inicializar los microservomotores
  // Se asignan los servos a los pines físicos extraídos del puerto 7
  servoGarra1.attach(placaExpansora.pin1());
  servoGarra2.attach(placaExpansora.pin2());
  
  // Posición inicial por defecto: siempre en 180 grados
  miServo.write(0);

  // Inicializamos los pines de los servos
  servoGarra1.attach(placaExpansora.pin1());
  servoGarra2.attach(placaExpansora.pin2());
  
  // Condición inicial: Empezar con la garra abierta
  abrirGarra();

  //MOTORES

  TCCR1A = _BV(WGM10);
  TCCR1B = _BV(CS11) | _BV(WGM12);
  TCCR2A = _BV(WGM21) | _BV(WGM20);
  TCCR2B = _BV(CS21);
  
  attachInterrupt(Encoder_1.getIntNum(), isr_process_encoder1, RISING);
  Encoder_1.setPulse(8);
  Encoder_1.setRatio(46.67);
  Encoder_1.setPosPid(1.8,0,1.2);
  Encoder_1.setSpeedPid(0.18,0,0);
  
  attachInterrupt(Encoder_2.getIntNum(), isr_process_encoder2, RISING);
  Encoder_2.setPulse(8);
  Encoder_2.setRatio(46.67);
  Encoder_2.setPosPid(1.8,0,1.2);
  Encoder_2.setSpeedPid(0.18,0,0);
}

void loop() {
  Serial.println("Up");

  // 1. ESPERAR A QUE SE PRESIONE EL BOTÓN PARA INICIAR
  while (digitalRead(BOTON_PIN) == HIGH) {
    _loop(); 
  }
  // 2. ESPERAR A QUE SE SUELTE EL BOTÓN. Esto evita que te canceles a ti mismo por dejar el dedo puesto
  while (digitalRead(BOTON_PIN) == LOW) {
    _loop();
  }
  // 3. PAUSA DE SEGURIDAD
  _delay(0.5);
  // 4. ¡ACTIVAR EL MODO COMPETENCIA!
  // A partir de esta línea, si presionas el botón, el robot se detendrá por completo
  rutinaIniciada = true;

  // ==========================================
  // TU RUTINA DE MOVIMIENTO
  // ==========================================

  // Giro a la izquierda: límite máximo 90°, empieza a buscar línea tras 50°
  girarIzquierdaGyroLinea(115.0, 50.0, 70.0);
  // Avanzar siguiendo la línea por 600 grados de encoder a velocidad 80
  seguirLineaGrados(400, 50);
  // Avanzar siguiendo la línea por 2.5 segundos a velocidad 70
  seguirLineaTiempo(2.5, 60);
  
  /*
  avanzar(580, 90, 3.0);
  
  //girarIzquierda(329, 55, 3.5);
  girarIzquierdaGyro(80.0, 50.0);
  avanzar(271, 80, 2.6);
  girarDerechaGyro(77.0, 39.0);
  avanzar(206, 80, 2.5);
  
  bajar_pala();

  retroceder(1650, 33, 4.5);
  avanzar(85, 120, 0.5);
  girarDerechaGyro(95.0, 30.0);
  
  avanzar(2000, 100, 2); 
  avanzar(2000, 105, 2.25);
  retroceder(45, 40, 1.0);
  
  detener(1.0);
  subir_pala();
 */

  // Bucle infinito para que no repita la rutina en la competencia
  while(1) {
    _loop();
  }
}