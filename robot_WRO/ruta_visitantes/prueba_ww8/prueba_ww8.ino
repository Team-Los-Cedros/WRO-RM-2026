// generated by mBlock5 for MegaPi
// Optimized for WRO Robomission Junior
// VERSION CORREGIDA: giros por giroscopio inmunes al salto +-180 grados

#include <Arduino.h>
#include <Wire.h>
#include <SoftwareSerial.h>
#include <MeMegaPi.h>

#define BOTON_PIN 4
#define PIN_TCRT_IZQ A4
#define PIN_TCRT_DER A3

MeGyro giroscopio(8);

MePort placaExpansora(7); // Define el Puerto 7 como adaptador RJ25
Servo servoGarra1;
Servo servoGarra2;
Servo miServo; // Declarado aquí arriba para que todas las funciones (como parabrisas) lo reconozcan

double angle_rad = PI/180.0;
double angle_deg = 180.0/PI;
MeEncoderOnBoard Encoder_1(SLOT1); // Motor Izquierdo
MeEncoderOnBoard Encoder_2(SLOT2); // Motor Derecho

void isr_process_encoder1(void){
  if(digitalRead(Encoder_1.getPortB()) == 0){
    Encoder_1.pulsePosMinus();
  }else{
    Encoder_1.pulsePosPlus();
  }
}

void isr_process_encoder2(void){
  if(digitalRead(Encoder_2.getPortB()) == 0){
    Encoder_2.pulsePosMinus();
  }else{
    Encoder_2.pulsePosPlus();
  }
}

// Variable para saber si estamos en espera o si el robot ya está compitiendo
bool rutinaIniciada = false;

void _loop() {
  unsigned long tiempoActual = millis(); 
  
  // Actualizar los motores solo cada 10 milisegundos
  static unsigned long ultimoTiempoMotores = 0;
  if(tiempoActual - ultimoTiempoMotores >= 10) {
    Encoder_1.loop();
    Encoder_2.loop();
    ultimoTiempoMotores = tiempoActual;
  }
  
  // Actualizar el giroscopio solo cada 25 milisegundos
  static unsigned long ultimoGiroscopio = 0;
  if(tiempoActual - ultimoGiroscopio >= 25) {
    giroscopio.update();
    ultimoGiroscopio = tiempoActual;
  }

  // Si la rutina ya empezó y el botón se vuelve a presionar (estado LOW)
  if (rutinaIniciada == true && digitalRead(BOTON_PIN) == LOW) {
    // 1. Mandamos la orden de velocidad y posición a 0
    Encoder_1.move(0, 0); 
    Encoder_2.move(0, 0);
    // Forzar el PWM a 0
    Encoder_1.setTarPWM(0);
    Encoder_2.setTarPWM(0);
    
    // Guardamos el momento exacto en el que empezamos a frenar
    unsigned long inicioParada = millis();
    
    // 2. Atrapamos al robot en un bucle infinito
    while (true) {
      tiempoActual = millis(); 
      
      // FASE 1: Durante los primeros 1500ms, mantenemos vivo el cerebro del motor para que frene
      if (tiempoActual - inicioParada < 1500) {
        if(tiempoActual - ultimoTiempoMotores >= 10) {
          Encoder_1.loop();
          Encoder_2.loop();
          ultimoTiempoMotores = tiempoActual;
        }
      } 
      // FASE 2: Pasado ese tiempo, ya no entra al 'if' anterior. 
      // Al dejar de llamar a .loop(), los motores pierden la tensión y el zumbido desaparece.
      else {
        // El robot está congelado, los motores apagados y sin zumbar.
        delay(500);
      }
    }
  }
}

void _delay(float seconds) {
  if(seconds < 0.0){
    seconds = 0.0;
  }
  unsigned long endTime = millis() + (unsigned long)(seconds * 1000.0);
  
  while(millis() < endTime) {
    _loop();
    delay(2); // <--- ESTA LÍNEA ES LA MAGIA. Evita que la placa colapse.
  }
}

// =========================================================================
// NUESTRAS FUNCIONES DE MOVIMIENTO
// =========================================================================

/**
 * Función maestra para controlar ambos motores.
 * Para ambos motores: valores positivos = adelante, valores negativos = atrás.
 */
void moverRobot(long gradosIzq, long gradosDer, float velocidad, float tiempoEspera) {
  Encoder_1.move(gradosIzq, abs(velocidad));
  Encoder_2.move(-gradosDer, abs(velocidad*1.02));
  _delay(tiempoEspera);
}

// Mueve el robot en línea recta hacia adelante
void avanzar(long grados, float velocidad, float tiempoEspera) {
  moverRobot(grados, grados, velocidad, tiempoEspera);
}

// Mueve el robot en línea recta hacia atrás
void retroceder(long grados, float velocidad, float tiempoEspera) {
  moverRobot(-grados, -grados, velocidad, tiempoEspera);
}

// Gira sobre su propio eje hacia la izquierda (por encoder)
void girarIzquierda(long grados, float velocidad, float tiempoEspera) {
  moverRobot(grados, -grados, velocidad, tiempoEspera);
}

// Gira sobre su propio eje hacia la derecha (por encoder)
void girarDerecha(long grados, float velocidad, float tiempoEspera) {
  moverRobot(-grados, grados, velocidad, tiempoEspera);
}

// Detiene por completo los motores
void detener(float tiempoEspera) {
  Encoder_1.setTarPWM(0);
  Encoder_2.setTarPWM(0);
}

// =========================================================================
// FUNCIONES DE GIRO CON GIROSCOPIO
// =========================================================================
//
// CORRECCION CLAVE:
// MeGyro.getAngleZ() devuelve un valor limitado al rango -180 a +180 grados.
// Cuando el rumbo acumulado del robot cruza ese limite, la lectura salta de
// +180 a -180 (o al reves). Comparar contra el angulo inicial de forma
// absoluta hacia que la resta se disparara a ~350 de golpe y el giro se
// cortara antes de tiempo. Por eso fallaba SOLO en algunos giros.
//
// Solucion: acumulamos la diferencia entre lecturas consecutivas corrigiendo
// el salto. Asi el giro es inmune al +-180 y admite giros de 180 o 360 grados.
// =========================================================================

/**
 * Devuelve la diferencia angular REAL entre dos lecturas consecutivas,
 * corrigiendo el salto de +-180 grados.
 */
float deltaAngulo(float actual, float previo) {
  float d = actual - previo;
  while (d >  180.0) d -= 360.0;
  while (d < -180.0) d += 360.0;
  return d;
}

/**
 * Motor de giro por giroscopio.
 * @param gradosObjetivo Grados a girar (siempre positivo).
 * @param velocidad Velocidad de giro.
 * @param sentido +1 = izquierda, -1 = derecha.
 * @param timeoutSeg Tiempo limite de seguridad.
 */
void girarGyro(float gradosObjetivo, float velocidad, int sentido, float timeoutSeg = 5.0) {
  giroscopio.update();
  float anguloPrevio = giroscopio.getAngleZ();
  float acumulado = 0.0;

  float v = (sentido > 0) ? fabs(velocidad) : -fabs(velocidad);
  Encoder_1.runSpeed(v);
  Encoder_2.runSpeed(v);

  unsigned long tiempoInicio = millis();
  unsigned long timeoutMs = (unsigned long)(timeoutSeg * 1000.0);

  while (fabs(acumulado) < gradosObjetivo) {
    _loop();

    float anguloActual = giroscopio.getAngleZ();
    acumulado += deltaAngulo(anguloActual, anguloPrevio);
    anguloPrevio = anguloActual;

    if (millis() - tiempoInicio > timeoutMs) {
      Serial.print("TIMEOUT en giro - grados acumulados: ");
      Serial.println(acumulado);
      break;
    }
  }

  Encoder_1.runSpeed(0);
  Encoder_2.runSpeed(0);
  _delay(0.3);
}

void girarIzquierdaGyro(float gradosObjetivo, float velocidad) {
  girarGyro(gradosObjetivo, velocidad, +1);
}

void girarDerechaGyro(float gradosObjetivo, float velocidad) {
  girarGyro(gradosObjetivo, velocidad, -1);
}

// =========================================================================
// SENSORES DE LÍNEA TCRT5000 Y NAVEGACIÓN
// =========================================================================

// Umbral analógico para diferenciar superficie clara de línea negra
int UMBRAL_NEGRO_DER = 55;
int UMBRAL_NEGRO_IZQ = 31;

int leerLineaIzq() {
  return analogRead(PIN_TCRT_IZQ);
}

int leerLineaDer() {
  return analogRead(PIN_TCRT_DER);
}

bool esNegroIzq() {
  return leerLineaIzq() >= UMBRAL_NEGRO_IZQ;
}

bool esNegroDer() {
  return leerLineaDer() >= UMBRAL_NEGRO_DER;
}

void imprimirSensoresLinea() {
  Serial.print("TCRT Izq (A4): ");
  Serial.print(leerLineaIzq());
  Serial.print(" | TCRT Der (A3): ");
  Serial.println(leerLineaDer());
}

/**
 * Centra el robot sobre la línea negra usando micro-ajustes.
 */
void centrarEnLinea(float velocidad, float timeoutSeg) {
  unsigned long inicio = millis();
  unsigned long timeoutMs = (unsigned long)(timeoutSeg * 1000.0);
  float velFina = fabs(velocidad) * 0.6; // Velocidad reducida para mayor precisión

  while (millis() - inicio < timeoutMs) {
    _loop();
    bool izqNegro = esNegroIzq();
    bool derNegro = esNegroDer();

    // Si ambos detectan negro o ambos blanco, el robot ya está centrado
    if ((izqNegro && derNegro) || (!izqNegro && !derNegro)) {
      Encoder_1.runSpeed(0);
      Encoder_2.runSpeed(0);
      break;
    } 
    else if (izqNegro && !derNegro) {
      // Línea hacia la izquierda -> girar izquierda
      Encoder_1.runSpeed(velFina);
      Encoder_2.runSpeed(velFina);
    } 
    else if (!izqNegro && derNegro) {
      // Línea hacia la derecha -> girar derecha
      Encoder_1.runSpeed(-velFina);
      Encoder_2.runSpeed(-velFina);
    }
    delay(5);
  }

  Encoder_1.runSpeed(0);
  Encoder_2.runSpeed(0);
  _delay(0.1);
}

/**
 * Motor de giro con giroscopio + busqueda de linea negra.
 * Usa la misma correccion de salto +-180 que girarGyro().
 *
 * @param gradosMaximos Límite máximo de grados a girar si el sensor no detecta la línea.
 * @param velocidad Velocidad de giro.
 * @param sentido +1 = izquierda, -1 = derecha.
 * @param gradosMinimosBusqueda Grados girados ANTES de activar la búsqueda por sensor.
 * @param timeoutSeg Tiempo límite de seguridad en segundos.
 */
void girarGyroLinea(float gradosMaximos, float velocidad, int sentido,
                    float gradosMinimosBusqueda, float timeoutSeg = 4.0) {
  giroscopio.update();
  float anguloPrevio = giroscopio.getAngleZ();
  float acumulado = 0.0;

  unsigned long tiempoInicio = millis();
  unsigned long timeoutMs = (unsigned long)(timeoutSeg * 1000.0);

  float v = (sentido > 0) ? fabs(velocidad) : -fabs(velocidad);
  Encoder_1.runSpeed(v);
  Encoder_2.runSpeed(v);

  bool lineaDetectada = false;

  while (fabs(acumulado) < gradosMaximos) {
    _loop();

    float anguloActual = giroscopio.getAngleZ();
    acumulado += deltaAngulo(anguloActual, anguloPrevio);
    anguloPrevio = anguloActual;

    // Activar la lectura de la línea solo después de cumplir los grados mínimos
    if (fabs(acumulado) >= gradosMinimosBusqueda) {
      if (esNegroIzq() || esNegroDer()) {
        lineaDetectada = true;
        break; // Detener giro inmediatamente al detectar la línea
      }
    }

    if (millis() - tiempoInicio > timeoutMs) {
      Serial.print("TIMEOUT en girarGyroLinea - grados acumulados: ");
      Serial.println(acumulado);
      break;
    }
  }

  Encoder_1.runSpeed(0);
  Encoder_2.runSpeed(0);
  _delay(0.1);

  // Si se detectó la línea, realizar el centrado fino
  if (lineaDetectada) {
    centrarEnLinea(velocidad, 4.0); // antes decia 40.0 (40 segundos): era demasiado
  }
}

void girarIzquierdaGyroLinea(float gradosMaximos, float velocidad, float gradosMinimosBusqueda, float timeoutSeg = 4.0) {
  girarGyroLinea(gradosMaximos, velocidad, +1, gradosMinimosBusqueda, timeoutSeg);
}

void girarDerechaGyroLinea(float gradosMaximos, float velocidad, float gradosMinimosBusqueda, float timeoutSeg = 4.0) {
  girarGyroLinea(gradosMaximos, velocidad, -1, gradosMinimosBusqueda, timeoutSeg);
}

/**
 * Avanza siguiendo la línea negra durante un tiempo determinado (en segundos).
 */
void seguirLineaTiempo(float segundos, float velocidadBase, float Kp = 0.15) {
  unsigned long inicio = millis();
  unsigned long duracionMs = (unsigned long)(segundos * 1000.0);

  while (millis() - inicio < duracionMs) {
    _loop();

    int lectIzq = leerLineaIzq();
    int lectDer = leerLineaDer();

    int error = lectIzq - lectDer;
    float correccion = error * Kp;

    float velIzq = velocidadBase - correccion;
    float velDer = velocidadBase + correccion;

    Encoder_1.runSpeed(velIzq);
    Encoder_2.runSpeed(-velDer);

    delay(5);
  }

  Encoder_1.runSpeed(0);
  Encoder_2.runSpeed(0);
  _delay(0.1);
}

/**
 * Avanza siguiendo la línea negra durante una cantidad de grados de encoder.
 */
void seguirLineaGrados(long grados, float velocidadBase, float Kp = 0.15, float tiempoMax = 10.0) {
  long posInicialIzq = Encoder_1.getCurPos();
  long posInicialDer = Encoder_2.getCurPos();

  unsigned long inicio = millis();
  unsigned long timeoutMs = (unsigned long)(tiempoMax * 1000.0);

  while (millis() - inicio < timeoutMs) {
    _loop();

    long avanceIzq = abs(Encoder_1.getCurPos() - posInicialIzq);
    long avanceDer = abs(Encoder_2.getCurPos() - posInicialDer);
    long promedioAvance = (avanceIzq + avanceDer) / 2;

    if (promedioAvance >= grados) {
      break;
    }

    int lectIzq = leerLineaIzq();
    int lectDer = leerLineaDer();

    int error = lectIzq - lectDer;
    float correccion = error * Kp;

    float velIzq = velocidadBase - correccion;
    float velDer = velocidadBase + correccion;

    Encoder_1.runSpeed(velIzq);
    Encoder_2.runSpeed(-velDer);

    delay(5);
  }

  Encoder_1.runSpeed(0);
  Encoder_2.runSpeed(0);
  _delay(0.1);
}

/**
 * Avanza recto manteniendo el rumbo con el giroscopio.
 * Tambien usa deltaAngulo() para no romperse si cruza el +-180.
 */
void avanzarRectoGyro(long grados, float velocidadBase, float Kp = 1.5, float tiempoMax = 10.0) {
  giroscopio.update();
  float anguloPrevio = giroscopio.getAngleZ();
  float desvio = 0.0; // desviacion acumulada respecto al rumbo inicial

  long posInicialIzq = Encoder_1.getCurPos();
  long posInicialDer = Encoder_2.getCurPos();

  unsigned long inicio = millis();
  unsigned long timeoutMs = (unsigned long)(tiempoMax * 1000.0);

  while (millis() - inicio < timeoutMs) {
    _loop();

    long avanceIzq = abs(Encoder_1.getCurPos() - posInicialIzq);
    long avanceDer = abs(Encoder_2.getCurPos() - posInicialDer);
    long promedioAvance = (avanceIzq + avanceDer) / 2;

    if (promedioAvance >= grados) {
      break; 
    }

    float anguloActual = giroscopio.getAngleZ();
    desvio += deltaAngulo(anguloActual, anguloPrevio);
    anguloPrevio = anguloActual;

    float correccion = desvio * Kp;

    float velIzq = velocidadBase - correccion;
    float velDer = velocidadBase + correccion;

    Encoder_1.runSpeed(velIzq);
    Encoder_2.runSpeed(-velDer);

    delay(5);
  }

  Encoder_1.runSpeed(0);
  Encoder_2.runSpeed(0);
  _delay(0.1);
}

// =========================================================================
// DE LOS SERVOMOTORES PEQUEÑOS
// =========================================================================

const int GARRA_ABIERTA_S1 = 0;
const int GARRA_CERRADA_S1 = 108;
const int GARRA_CERRADA_S2 = 58;
const int GARRA_ABIERTA_S2 = 180;

void abrirGarra() {
  servoGarra1.write(GARRA_ABIERTA_S1);
  servoGarra2.write(GARRA_ABIERTA_S2);
  _delay(1.0);
}

void cerrarGarra() {
  servoGarra1.write(GARRA_CERRADA_S1);
  servoGarra2.write(GARRA_CERRADA_S2);
  _delay(1.0);
}

/**
 * FUNCIÓN PARABRISAS:
 * Mueve ambos micro-servos juntos hacia la izquierda y luego hacia la derecha.
 * Se detiene inmediatamente al terminar la distancia de avance.
 */
void parabrisas(long pasos, float velocidad = 60.0) {
  int izqS1 = 0;
  int izqS2 = 0;
  int derS1 = 180;
  int derS2 = 180;

  servoGarra1.write(izqS1);
  servoGarra2.write(izqS2);
  _delay(0.5);

  miServo.write(115);
  _delay(0.5);

  long posInicialIzq = Encoder_1.getCurPos();
  long posInicialDer = Encoder_2.getCurPos();

  Encoder_1.move(pasos, abs(velocidad));
  Encoder_2.move(-pasos, abs(velocidad * 1.02));

  bool enIzquierda = true;

  unsigned long inicioAvance = millis();
  unsigned long timeoutAvance = (unsigned long)((pasos / abs(velocidad)) * 2000.0) + 2000;

  while (true) {
    _loop();

    long avanceIzq = abs(Encoder_1.getCurPos() - posInicialIzq);
    long avanceDer = abs(Encoder_2.getCurPos() - posInicialDer);
    long promedioAvance = (avanceIzq + avanceDer) / 2;

    if (promedioAvance >= (pasos - 15) || (millis() - inicioAvance > timeoutAvance)) {
      break;
    }

    if (enIzquierda) {
      servoGarra1.write(derS1);
      servoGarra2.write(derS2);
      enIzquierda = false;
    } else {
      servoGarra1.write(izqS1);
      servoGarra2.write(izqS2);
      enIzquierda = true;
    }

    _delay(0.35);
  }

  // Detener inmediatamente los motores y el movimiento de parabrisas al terminar de avanzar
  Encoder_1.setTarPWM(0);
  Encoder_2.setTarPWM(0);
  _delay(0.1);

  // Bajar la pala a 114 grados
  miServo.write(114);
  _delay(0.5);
}

// =========================================================================
// DEL SERVOMOTOR GRANDE
// =========================================================================

const int pinServo = 5;
const int anguloBajar = 105;

void subir_pala() {
  for (int angulo = anguloBajar; angulo >= 0; angulo--) {
    miServo.write(angulo);
    _delay(0.050); // Ajusta este tiempo para cambiar la velocidad
  }
  _delay(1.0);
}

void bajar_pala() {
  miServo.write(anguloBajar);
  _delay(1.0);
}

void barrer() {
  abrirGarra();
  miServo.write(117);
  _delay(1.0);
}

// Subir el servo para llevar el objeto
void recolectar(int modo) {
  if (modo == 1) {
    miServo.write(63);
  } else if (modo == 2) {
    miServo.write(120);
  }
  _delay(1.0);
}

void posicionar() {
  miServo.write(50);
  _delay(1.0);
}

// Bajar el servo para soltar el objeto
void depositar() {
  miServo.write(40);
  _delay(1.0);
  abrirGarra();
}

// =========================================================================

void setup() {
  Serial.begin(115200);

  pinMode(BOTON_PIN, INPUT_PULLUP); 
  pinMode(PIN_TCRT_IZQ, INPUT);
  pinMode(PIN_TCRT_DER, INPUT);
  
  Wire.setWireTimeout(3000, true); // 3000 microsegundos, reset automático del bus si se cuelga
  giroscopio.begin();
  _delay(2.0);    // Espera 2 segundos completamente quieto para calibrar

  // Asociamos el SERVO al pin 5
  miServo.attach(pinServo);

  // Se asignan los microservos a los pines físicos extraídos del puerto 7
  servoGarra1.attach(placaExpansora.pin1());
  servoGarra2.attach(placaExpansora.pin2());
  
  // Posición inicial por defecto
  miServo.write(0);
  
  // Condición inicial: Empezar con la garra abierta
  abrirGarra();

  // MOTORES

  TCCR1A = _BV(WGM10);
  TCCR1B = _BV(CS11) | _BV(WGM12);
  TCCR2A = _BV(WGM21) | _BV(WGM20);
  TCCR2B = _BV(CS21);
  
  attachInterrupt(Encoder_1.getIntNum(), isr_process_encoder1, RISING);
  Encoder_1.setPulse(8);
  Encoder_1.setRatio(46.67);
  Encoder_1.setPosPid(1.8,0,1.2);
  Encoder_1.setSpeedPid(0.18,0,0);
  
  attachInterrupt(Encoder_2.getIntNum(), isr_process_encoder2, RISING);
  Encoder_2.setPulse(8);
  Encoder_2.setRatio(46.67);
  Encoder_2.setPosPid(1.8,0,1.2);
  Encoder_2.setSpeedPid(0.18,0,0);
}

void loop() {
  Serial.println("Up");

  // 1. ESPERAR A QUE SE PRESIONE EL BOTÓN PARA INICIAR
  while (digitalRead(BOTON_PIN) == HIGH) {
    _loop(); 
  }
  // 2. ESPERAR A QUE SE SUELTE EL BOTÓN
  while (digitalRead(BOTON_PIN) == LOW) {
    _loop();
  }
  // 3. PAUSA DE SEGURIDAD
  _delay(0.5);
  // 4. ¡ACTIVAR EL MODO COMPETENCIA!
  rutinaIniciada = true;

  // ==========================================
  // TU RUTINA DE MOVIMIENTO (sin cambios)
  // ==========================================

/* colores no aleatorios*/
  girarDerechaGyro(85.0, 20.0);
  avanzarRectoGyro(200, 50, 1.5, 2.5);
  girarIzquierdaGyro(85.0, 20.0);
 
  avanzarRectoGyro(750, 50, 1.5, 6.5);
  recolectar(2);
  retroceder(600, 25, 4.5);

  girarIzquierdaGyro(85.0, 50.0);
   avanzarRectoGyro(1300, 55, 1.5, 4.5);

  // Estos dos giros de 90 se podrian unir en girarIzquierdaGyro(180.0, 50.0)
  // si la pausa de en medio no te hace falta. Los dejo tal cual por si la necesitas.
 girarIzquierdaGyro(172.0, 30.0);
  subir_pala();

  retroceder(200, 25, 2.5);
  girarDerechaGyro(30.0, 50.0);
  avanzar(320, 60, 3.5);
  recolectar(2);
  girarDerechaGyro(50.0, 50.0);

  avanzar(510, 60, 3.5);
  recolectar(1);
  avanzar(55, 60, 3.5);
  retroceder(450, 25, 4.5);

  // ---- ESTE ERA EL GIRO QUE FALLABA (cruzaba el +-180) ----
 
  girarIzquierdaGyro(160.0, 50.0);
  avanzar(250, 60, 1.5);
  avanzar(700, 60, 3.5);

girarIzquierdaGyro(20.0, 50.0);
retroceder(650, 25, 4.5);


 girarDerechaGyro(80.0, 50.0);
 avanzar(860, 60, 3.5);
 girarIzquierdaGyro(85.0, 50.0);

 avanzar(460, 60, 3.5);
 recolectar(2);
 retroceder(680, 25, 4.5);

 girarIzquierdaGyro(82.0, 30.0);
 avanzar(2500, 60, 6.5);
 recolectar(1);

 retroceder(200, 25, 4.5);
 girarIzquierdaGyro(25.0, 50.0);
 avanzar(300, 60, 3.5);

 recolectar(2);
 parabrisas(700);

  // Bucle infinito para que no repita la rutina en la competencia
  while(1) {
    _loop();
  }
}