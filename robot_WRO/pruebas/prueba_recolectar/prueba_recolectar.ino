// generated by mBlock5 for MegaPi
// Optimized for WRO Robomission Junior

#include <Arduino.h>
#include <Wire.h>
#include <SoftwareSerial.h>
#include <MeMegaPi.h>

double angle_rad = PI/180.0;
double angle_deg = 180.0/PI;
MeEncoderOnBoard Encoder_1(SLOT1); // Motor Izquierdo
MeEncoderOnBoard Encoder_2(SLOT2); // Motor Derecho
MeEncoderOnBoard Encoder_3(SLOT3);
MeEncoderOnBoard Encoder_4(SLOT4);

void isr_process_encoder1(void){
  if(digitalRead(Encoder_1.getPortB()) == 0){
    Encoder_1.pulsePosMinus();
  }else{
    Encoder_1.pulsePosPlus();
  }
}

void isr_process_encoder2(void){
  if(digitalRead(Encoder_2.getPortB()) == 0){
    Encoder_2.pulsePosMinus();
  }else{
    Encoder_2.pulsePosPlus();
  }
}

void _loop() {
  Encoder_1.loop();
  Encoder_2.loop();
}

void _delay(float seconds) {
  if(seconds < 0.0){
    seconds = 0.0;
  }
  long endTime = millis() + seconds * 1000;
  while(millis() < endTime) _loop();
}

// =========================================================================
// NUESTRAS FUNCIONES DE MOVIMIENTO
// =========================================================================

/**
 * Función maestra para controlar ambos motores.
 * Para ambos motores: valores positivos = adelante, valores negativos = atrás.
 */
void moverRobot(long gradosIzq, long gradosDer, float velocidad, float tiempoEspera) {
  // Encoder_1 (Izquierdo): se queda igual
  Encoder_1.move(gradosIzq, abs(velocidad));
  
  // Encoder_2 (Derecho): se invierte con el signo menos (-) 
  // para que los valores positivos vayan hacia adelante.
  Encoder_2.move(-gradosDer, abs(velocidad));
  
  _delay(tiempoEspera);
}

// Mueve el robot en línea recta hacia adelante
void avanzar(long grados, float velocidad, float tiempoEspera) {
  moverRobot(grados, grados, velocidad, tiempoEspera);
}

// Mueve el robot en línea recta hacia atrás
void retroceder(long grados, float velocidad, float tiempoEspera) {
  moverRobot(-grados, -grados, velocidad, tiempoEspera);
}

// Gira sobre su propio eje hacia la derecha
void girarIzquierda(long grados, float velocidad, float tiempoEspera) {
  moverRobot(grados, -grados, velocidad, tiempoEspera);
}

// Gira sobre su propio eje hacia la izquierda
void girarDerecha(long grados, float velocidad, float tiempoEspera) {
  moverRobot(-grados, grados, velocidad, tiempoEspera);
}

// Detiene por completo los motores
void detener(float tiempoEspera) {
  moverRobot(0, 0, 0, tiempoEspera);
}

// =========================================================================
// DEL SERVOMOTOR GRANDE
// =========================================================================

// Creamos el objeto servo
Servo miServo;
// Definimos el pin del servo
const int pinServo = 5;

// Mueve el servo 90° hacia arriba (va a 180°)
const int anguloBajar = 116;
void subir_pala() {
  for (int angulo = anguloBajar; angulo >= 0; angulo--) {
    miServo.write(angulo);
    _delay(0.050); // Ajusta este tiempo para cambiar la velocidad
  }
  _delay(1.0);
}

// Regresa el servo a la posición central (90°)
void bajar_pala() {
  miServo.write(anguloBajar);
  _delay(1.0);
}

// Baja el servo 35° desde el centro (90 - 35 = 55°)
void barrer() {
  miServo.write(117);
  _delay(1.0);
}

// =========================================================================

void setup() {
  // Asociamos el SERVO al pin 5
  miServo.attach(pinServo);
  
  // Posición inicial por defecto: siempre en 180 grados
  miServo.write(0);

  //MOTORES

  TCCR1A = _BV(WGM10);
  TCCR1B = _BV(CS11) | _BV(WGM12);
  TCCR2A = _BV(WGM21) | _BV(WGM20);
  TCCR2B = _BV(CS21);
  
  attachInterrupt(Encoder_1.getIntNum(), isr_process_encoder1, RISING);
  Encoder_1.setPulse(8);
  Encoder_1.setRatio(46.67);
  Encoder_1.setPosPid(1.8,0,1.2);
  Encoder_1.setSpeedPid(0.18,0,0);
  
  attachInterrupt(Encoder_2.getIntNum(), isr_process_encoder2, RISING);
  Encoder_2.setPulse(8);
  Encoder_2.setRatio(46.67);
  Encoder_2.setPosPid(1.8,0,1.2);
  Encoder_2.setSpeedPid(0.18,0,0);
}

void loop() {
  _delay(1.0);
  
  avanzar(580, 80, 3.0);
  detener(0.5);
  girarIzquierda(329, 55, 3.5);
  detener(0.5);
  avanzar(515, 80, 3.0);

  bajar_pala();

  retroceder(680, 40, 4.5);

  girarIzquierda(378, 48, 4.5);
  avanzar(480, 80, 3.0);
  girarIzquierda(330, 50, 4.5);


  avanzar(2000, 100, 2); 
  avanzar(2000, 105, 2.25);
  retroceder(45, 40, 1.0);
  detener(1.0);
  subir_pala();
 

  // Bucle infinito para que no repita la rutina en la competencia
  while(1) {
    _loop();
  }
}